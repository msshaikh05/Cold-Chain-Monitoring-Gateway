## prj.conf
```kconfig
CONFIG_GPIO=y

CONFIG_BT=y
CONFIG_BT_PERIPHERAL=y
CONFIG_BT_DEVICE_NAME="ColdChain_Slave"

CONFIG_ENTROPY_GENERATOR=y
CONFIG_TEST_RANDOM_GENERATOR=y

CONFIG_LOG=y
CONFIG_LOG_DEFAULT_LEVEL=3
```

## src/main.c
```c
#include <zephyr/kernel.h>
#include "dht11_timer_isr.h"
#include "led_control.h"
#include "ble_gatt.h"
#include "ui.h"


int main(void)
{
    dht11_timer_init();
    ble_init();

    while (1) {
        led_control_update();
        ble_notify_data();
        serial_ui_print();
        k_sleep(K_SECONDS(5));
    }
}
```

## include/ble_gatt.h
```c
#pragma once
void ble_init(void);
void ble_notify_data(void);
```

## include/led_control.h
```c
#pragma once
void led_control_update(void);
```

## src/ble_gatt.c
```c
#include <zephyr/bluetooth/bluetooth.h>
#include <zephyr/bluetooth/gatt.h>
#include <string.h>
#include <stdbool.h>

#include "dht11_timer_isr.h"

/* UI status flag */
extern bool ble_tx_done;

static uint8_t payload[8];

BT_GATT_SERVICE_DEFINE(coldchain_svc,
    BT_GATT_PRIMARY_SERVICE(BT_UUID_DECLARE_128(
        0x12,0x34,0x56,0x78,0x9a,0xbc,0xde,0xf0,
        0xf0,0xde,0xbc,0x9a,0x78,0x56,0x34,0x12)),
    BT_GATT_CHARACTERISTIC(
        BT_UUID_DECLARE_128(
            0xab,0xcd,0xef,0x01,0x23,0x45,0x67,0x89,
            0x89,0x67,0x45,0x23,0x01,0xef,0xcd,0xab),
        BT_GATT_CHRC_NOTIFY,
        BT_GATT_PERM_NONE,
        NULL, NULL, payload),
);

void ble_notify_data(void)
{
    memcpy(payload, &g_temperature, 4);
    memcpy(payload + 4, &g_humidity, 4);

    bt_gatt_notify(NULL, &coldchain_svc.attrs[1],
                   payload, sizeof(payload));

    /* Mark BLE transmission done */
    ble_tx_done = true;
}

void ble_init(void)
{
    bt_enable(NULL);
    bt_le_adv_start(BT_LE_ADV_CONN_NAME, NULL, 0, NULL, 0);
}
```

## src/ui.c
```c
#include <zephyr/kernel.h>
#include <zephyr/sys/printk.h>
#include <stdbool.h>
#include "ui.h"

/* Extern globals */
extern float g_temperature;
extern float g_humidity;
extern bool g_sensor_error;
extern bool fan_on;
extern bool heater_on;
extern bool alert_on;
extern bool ble_tx_done;

#define WAREHOUSE_ID  "WH-PUNE-01"
#define BOX_ID        "BOX-CC-007"

void serial_ui_print(void)
{
    printk("\n");
    printk("=========================================\n");
    printk("   ❄️  COLD CHAIN MONITORING GATEWAY ❄️\n");
    printk("=========================================\n");
    printk(" Warehouse ID  : %s\n", WAREHOUSE_ID);
    printk(" Box ID        : %s\n", BOX_ID);
    printk("-----------------------------------------\n");
    printk(" Temperature   : %d.%02d °C\n",
       (int)g_temperature,
       (int)((g_temperature - (int)g_temperature) * 100));

    printk(" Humidity      : %d.%02d %%\n",
       (int)g_humidity,
       (int)((g_humidity - (int)g_humidity) * 100));

    printk("-----------------------------------------\n");
    printk(" Fan Status    : %s\n", fan_on ? "ON" : "OFF");
    printk(" Heater Status : %s\n", heater_on ? "ON" : "OFF");
    printk(" Alert Status  : %s\n", alert_on ? "ON" : "OFF");
    printk("-----------------------------------------\n");
    printk(" BLE Adv       : ACTIVE\n");
    printk(" BLE TX        : %s\n", ble_tx_done ? "DATA SENT" : "IDLE");
    printk(" Sensor Health : %s\n", g_sensor_error ? "FAULT ❌" : "OK ✅");
    printk("=========================================\n");
}
```
